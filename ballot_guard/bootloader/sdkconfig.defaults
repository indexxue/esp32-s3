## camera/components/ball_detect/Kconfig
```kconfig
menu "models: ball_detect"
    config FLASH_ESPDET_PICO_224_224_BALL
        bool "flash espdet_pico_224_224_ball"
        depends on !BALL_DETECT_MODEL_IN_SDCARD
        default y

    choice
        prompt "default ball_detect model"
        default ESPDET_PICO_224_224_BALL
        help
            default ball_detect model
        config ESPDET_PICO_224_224_BALL
            bool "espdet_pico_224_224_ball"
            depends on BALL_DETECT_MODEL_IN_SDCARD || FLASH_ESPDET_PICO_224_224_BALL
    endchoice

    config DEFAULT_BALL_DETECT_MODEL
        int
        default 0 if ESPDET_PICO_224_224_BALL

    choice
        prompt "ball_detect model location"
        default BALL_DETECT_MODEL_IN_FLASH_RODATA
        help
            ball_detect model location
        config BALL_DETECT_MODEL_IN_FLASH_RODATA
            bool "flash_rodata"
        config BALL_DETECT_MODEL_IN_FLASH_PARTITION
            bool "flash_partition"
        config BALL_DETECT_MODEL_IN_SDCARD
            bool "sdcard"
    endchoice

    config BALL_DETECT_MODEL_LOCATION
        int
        default 0 if BALL_DETECT_MODEL_IN_FLASH_RODATA
        default 1 if BALL_DETECT_MODEL_IN_FLASH_PARTITION
        default 2 if BALL_DETECT_MODEL_IN_SDCARD

    config BALL_DETECT_MODEL_SDCARD_DIR
        string "ball_detect model sdcard dir"
        default "models/s3" if IDF_TARGET_ESP32S3
        default "models/p4" if IDF_TARGET_ESP32P4
        depends on BALL_DETECT_MODEL_IN_SDCARD
        help
            Directory of models relative to sdcard mount point.
endmenu
```

## common/Kconfig
```kconfig
menu "OTA"

    config OTA_ROLLBACK_TEST
        bool "Crash in app_init before ota_confirm (O5 rollback test only)"
        default n
        help
            When enabled, app_init() calls abort() before ota_confirm_running_image().
            Build a test image, OTA-apply it to the inactive slot, reboot, and verify
            the bootloader rolls back to the previous slot.

            Do not enable in production firmware.

    config OTA_HTTPS_PULL
        bool "Enable HTTPS manifest/image pull (OTA phase 2)"
        default n
        help
            Stream-download release firmware from manifest.json URL into the OTA session.
            Requires esp_http_client and certificate bundle.

    config OTA_HTTPS_PULL_CHUNK
        depends on OTA_HTTPS_PULL
        int "HTTPS pull read chunk size (bytes)"
        default 4096
        range 1024 16384

    config OTA_HTTPS_PULL_MANIFEST_MAX
        depends on OTA_HTTPS_PULL
        int "Max manifest.json download size (bytes)"
        default 8192
        range 2048 65536

    config OTA_HTTPS_PULL_TIMEOUT_MS
        depends on OTA_HTTPS_PULL
        int "HTTPS GET timeout per connection (ms)"
        default 60000
        range 5000 300000

    config OTA_HTTPS_PULL_TASK_STACK
        depends on OTA_HTTPS_PULL
        int "Background ota_pull task stack (bytes)"
        default 8192
        range 4096 16384

endmenu
```

## components/web_ctrl/Kconfig
```kconfig
menu "Web Control Library (web_ctrl)"

    config WEB_CTRL_AUTO_START
        bool "Auto-start SoftAP + HTTP server after board init"
        default n
        help
            When enabled, application calls web_ctrl_start() with defaults after BoardInit().
            Default SoftAP SSID is ESP32-WebCtrl; change credentials in menuconfig or in code.

    config WEB_CTRL_CMD_SYNC_TIMEOUT_MS
        int "POST /api/cmd: max wait for command execution (ms)"
        default 3000
        range 500 60000
        help
            HTTP handler blocks until the web_ctrl_cmd task finishes cmd_process_line_for_web or times out (504).

    config WEB_CTRL_STA_CONNECT_TIMEOUT_MS
        int "STA connect wait before SoftAP fallback (ms), strategy A"
        default 15000
        range 3000 120000
        help
            When NVS has sta_ssid, web_ctrl_start tries STA first and waits this long for DHCP before falling back to SoftAP.

    config WEB_CTRL_BMP_UPLOAD_MAX
        int "POST /api/upload/bmp: max multipart body size (bytes)"
        default 1048576
        range 65536 8388608
        help
            Entire multipart body limit (headers + file + boundaries). BMP payload is typically far smaller.

    config WEB_CTRL_BMP_CMD_TIMEOUT_MS
        int "After BMP upload: max wait for optional lcdbmp on LCD (ms)"
        default 25000
        range 3000 120000
        help
            Used only when upload URL query includes display=1 (or on/yes).

    config WEB_CTRL_VIDEO_UPLOAD_MAX
        int "POST /api/upload/video: max multipart body size (bytes)"
        default 16777216
        range 1048576 33554432
        help
            Entire multipart body limit for MJPEG AVI upload to /sdcard/videos/.

    config WEB_CTRL_OTA
        bool "Enable SoftAP local OTA HTTP endpoints (/ota, /api/ota/*)"
        default n
        help
            Registers firmware upload/apply routes using common/ota. Intended for project/ maintenance.

    config WEB_CTRL_OTA_UPLOAD_MAX
        depends on WEB_CTRL_OTA
        int "POST /api/ota/upload: max firmware body size (bytes)"
        default 8388608
        range 65536 8388608
        help
            Raw application .bin size limit. Must not exceed inactive OTA slot size (~0x7E0000 on N16R8).

    config WEB_CTRL_OTA_CLOUD_PULL
        depends on WEB_CTRL_OTA
        bool "Enable POST /api/ota/pull (STA HTTPS cloud OTA)"
        default n
        help
            Registers cloud pull endpoint; requires CONFIG_OTA_HTTPS_PULL.
            Pull is allowed only when STA has IPv4 (device can reach the manifest URL).

endmenu
```

## desktop_pet/main/Kconfig.projbuild
```kconfig
menu "Desktop Pet Xiaozhi Agent"

config DESKTOP_PET_AGENT_ENABLE
    bool "Enable Xiaozhi WebSocket agent (Z1-2 hello)"
    default y
    help
        Connect to a xiaozhi-compatible server: WS handshake + hello.
        Opus streaming comes in later slices.

config DESKTOP_PET_AGENT_WS_URI
    string "WebSocket URI"
    depends on DESKTOP_PET_AGENT_ENABLE
    default "ws://192.168.10.198:8000/xiaozhi/v1/"
    help
        Official: wss://api.tenclass.net/xiaozhi/v1/
        LAN: ws://<PC-LAN-IP>:8000/xiaozhi/v1/ (not Docker 172.x).
        Not the console MCP URL (wss://api.xiaozhi.me/mcp/?token=...).

config DESKTOP_PET_AGENT_ACCESS_TOKEN
    string "Bearer access token (empty if server auth disabled)"
    depends on DESKTOP_PET_AGENT_ENABLE
    default ""
    help
        Official cloud default is test-token. LAN server often leaves this empty.

config DESKTOP_PET_AGENT_OTA_URL
    string "Xiaozhi OTA register URL (empty = skip)"
    depends on DESKTOP_PET_AGENT_ENABLE
    default ""
    help
        Device registration only (activation code). Firmware download URLs are ignored.
        Official: https://api.tenclass.net/xiaozhi/ota/
        LAN Docker: leave empty.

config DESKTOP_PET_AGENT_HELLO_TIMEOUT_MS
    int "Hello reply timeout (ms)"
    depends on DESKTOP_PET_AGENT_ENABLE
    range 3000 30000
    default 10000

endmenu
```

## voice_hub/sdkconfig.defaults
```kconfig
# N16R8 + dual OTA — voice_hub（OV2640 + ST7789 240×135 + 1-bit SDMMC）
CONFIG_IDF_TARGET="esp32s3"
CONFIG_IDF_TARGET_ESP32S3=y

CONFIG_ESPTOOLPY_FLASHSIZE_16MB=y
CONFIG_ESPTOOLPY_FLASHSIZE="16MB"

CONFIG_PARTITION_TABLE_CUSTOM=y
CONFIG_PARTITION_TABLE_CUSTOM_FILENAME="../flash_partition/partitions_16m_n16r8.csv"

# BoardInit 在 app_main 栈上；Web/Wi-Fi 在 web_boot 任务（与 project 一致）。
CONFIG_ESP_MAIN_TASK_STACK_SIZE=12288

# N16R8 OPI PSRAM（8MB）
CONFIG_SPIRAM=y
CONFIG_SPIRAM_MODE_OCT=y
CONFIG_SPIRAM_TYPE_AUTO=y
CONFIG_SPIRAM_SPEED_40M=y
CONFIG_SPIRAM_USE_MALLOC=y
CONFIG_SPIRAM_TRY_ALLOCATE_WIFI_LWIP=y
CONFIG_SPIRAM_MALLOC_ALWAYSINTERNAL=16384

CONFIG_ESP_DEFAULT_CPU_FREQ_MHZ_240=y
CONFIG_COMPILER_OPTIMIZATION_PERF=y

CONFIG_WEB_CTRL_AUTO_START=y

CONFIG_BOOTLOADER_APP_ROLLBACK_ENABLE=y
CONFIG_OTA_HTTPS_PULL=y
CONFIG_WEB_CTRL_OTA=y
CONFIG_WEB_CTRL_OTA_UPLOAD_MAX=8388608
CONFIG_WEB_CTRL_OTA_CLOUD_PULL=y
CONFIG_WEB_CTRL_OTA_DEFAULT_PRODUCT="voice_hub"

# OV2640 DVP（esp_cam_sensor）
CONFIG_CAMERA_OV2640=y
CONFIG_CAMERA_OV2640_AUTO_DETECT_DVP_INTERFACE_SENSOR=y
CONFIG_CAMERA_OV2640_DVP_RGB565_BE_240X240_25FPS=y
CONFIG_CAMERA_OV2640_DVP_DEFAULT_FMT_RGB565_BE_240X240_25FPS=y
CONFIG_ESP_CAM_SENSOR_PIXFORMAT_RGB565_BE=y
```
